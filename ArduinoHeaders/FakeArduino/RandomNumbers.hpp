//
// Created by Orlando on 10/8/2022.
//

#ifndef _FAKEARDUINOHEADERS_RANDOMNUMBERS_HPP
#define _FAKEARDUINOHEADERS_RANDOMNUMBERS_HPP

#define N 624
#define M 397
#define MATRIX_A 0x9908b0df
#define UPPER_MASK 0x80000000
#define LOWER_MASK 0x7fffffff

static unsigned long long mt[N];
static int mti = N + 1;

void _init_seed(unsigned long long seed)
{
    mt[0] = seed;
    for (mti = 1; mti < N; mti++) {
        mt[mti] = (1812433253 * (mt[mti - 1] ^ (mt[mti - 1] >> 30)) + mti);
    }
}

unsigned long long _rand() {
    unsigned y;
    static unsigned long long mag01[2] = {0, MATRIX_A};

    if (mti >= N) {
        int kk;

        if (mti == N + 1) {
            _init_seed(5489);
        }

        for (kk = 0; kk < N - M; kk++) {
            y = (mt[kk] & UPPER_MASK) | (mt[kk + 1] & LOWER_MASK);
            mt[kk] = mt[kk + M] ^ (y >> 1) ^ mag01[y & 1];
        }
        for (; kk < N - 1; kk++) {
            y = (mt[kk] & UPPER_MASK) | (mt[kk + 1] & LOWER_MASK);
            mt[kk] = mt[kk + (M - N)] ^ (y >> 1) ^ mag01[y & 1];
        }
        y = (mt[N - 1] & UPPER_MASK) | (mt[0] & LOWER_MASK);
        mt[N - 1] = mt[M - 1] ^ (y >> 1) ^ mag01[y & 1];

        mti = 0;
    }

    y = mt[mti++];
    y ^= (y >> 11);
    y ^= (y << 7) & 0x9d2c5680;
    y ^= (y << 15) & 0xefc60000;
    y ^= (y >> 18);

    return y;
}

#include <ctime>

/**
 * The random function generates pseudo-random numbers.
*/
template<typename T>
T random(T max) {
    _init_seed((unsigned long long)time(nullptr));
    return _rand() % max;
}

/**
 * The random function generates pseudo-random numbers.
*/
template<typename T>
T random(T min, T max) {
    _init_seed((unsigned long long)time(nullptr));
    return min + (_rand() % (max - min));
}

/**
 * randomSeed() initializes the pseudo-random number generator, causing it to start at an arbitrary point in
 * its random sequence. This sequence, while very long, and random, is always the same.
 *
 * If it is important for a sequence of values generated by random() to differ, on subsequent executions of a sketch,
 * use randomSeed() to initialize the random number generator with a fairly random input, such as analogRead() on
 * an unconnected pin.
 *
 * Conversely, it can occasionally be useful to use pseudo-random sequences that repeat exactly.
 * This can be accomplished by calling randomSeed() with a fixed number, before starting the random sequence.
 */
void randomSeed(unsigned long long seed) {
    _init_seed(seed);
}

#endif //_FAKEARDUINOHEADERS_RANDOMNUMBERS_HPP
